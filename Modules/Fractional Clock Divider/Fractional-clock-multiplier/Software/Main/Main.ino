#include <Metro.h> // Include the Metro library
#include <Encoder.h>
const int KnobCalibrateMode = 0;

//Define all the pins
const int SwPin_DivEuc = 0;  // Low input = switch in upper position
const int SwPin_DivEuc2 = 1;   // Low input = switch in lower position
const int SwPin_OutModes = 2;   // Low input = switch in upper position
const int SwPin_OutModes2 = 3;  // Low input = switch in lower position
const int SwPin_CVassign = 4;   //Low input = switch pressed
const int SwPin_Encoder = 7;
const int CtrPin_CVamt = 15;
const int CtrPin_Divisions = 19;
const int CtrPin_Length = 18;
const int OutPin_Cycle = 8;
const int OutPin_MainOut = 9;
const int OutPin_Thru = 10;
const int InPin_Trig = 11; //Low input voltage = HIGH reading on pin.
const int InPin_CV = 14;
const int InPin_Reset = 21;
const int LEDPin_Shuffle = 16;
const int LEDPin_CV_ind_Length = 23;
const int LEDPin_CV_ind_Divs = 22;
const int LEDPin_CV_ind_Shift = 17;
const int LEDPin_CV_ind_Shuffle = 20;
//const int LEDPin_internal = 13;
const int EncPinA = 5;
const int EncPinB = 6;

//recentPresses[] stores the times of the 6 most recent switch presses
//[0] = most recent, [5] = most distant
// every time we write to this, shuffle the array around
double recentClockTimes[6] = {0,0,0,0,0,0}; 
const int recentClockTimesArraySize = 6;

const double ButtonPressTimeout = 5000000; //in microseconds. if the time between two button presses is greater than this, do not use it to set the output clock. 

//sets the range for the Length and Division knobs
const int Divisions_min = 0;
const int Divisions_max = 16;
const int Length_min = 0;
const int Length_max = 16;
//To read Knob value: reading = map(analogRead(CtrPin_Length),0,1023,Length_min,Length_max);
const int LengthKnobLUTDividers[] = {33, 177, 411, 667, 919, 1178, 1474, 1784, 2113, 2443, 2743, 3012, 3276, 3552, 3835, 4032, 2060};
int ControlVoltage_in = 0;
int ControlValue_Divisions, ControlValue_Divisions_Scaled = 1;
int ControlValue_Length, ControlValue_Length_Scaled =1;

double pressTimeTemp = 0; //temporarily stores the time, when the button is pressed
int clockInState = 0;
int clockInPrevState = 0; // this will remember if the clock input was "on" in the previous cycle 
int resetInState = 0;
int resetInPrevState = 0;

//multiplication/division factors. These will eventually be controlled by pots.
//float ClicksPerCycle = 8;
float MultDivFactor2 = 2;
float MultDivFactor3 = 0.5;

Encoder EncKnob(EncPinB, EncPinA);
int EncoderValTemp = 0;
int EncoderShiftInstruction = 0; 
int intEncoderShuffleInstruction = 0;
float EncoderShuffleInstruction = 0.0;
const int EncoderCountsPerClick = 4; //property of the encoder used: how many digital output counts corresponding to one click (indent) felt by the user.
//const int EncoderClicksPerRevolution = 20; //property of the encoder used 
int EncoderShuffleNoOfClicks = 20; //The number of clicks of encoder rotation which makes the shuffle amount return to it's starting value
const int EncoderShuffleLedLUT[] = {0, 1, 1, 2, 3, 4, 5, 6, 7, 8, 9, 11, 13, 15, 17, 20, 23, 25, 30, 30, 20}; 
int intShuffleCVInstruction = 0;
int ShiftCVInstruction = 0;

bool CVcontrolCycleLength, CVcontrolDivisions, CVcontrolShuffle, CVcontrolShift;

bool EuclideanMode_temp = true; //if 0, runs as clock divider. If 1, runs as euclidean pattern generator. 

int Temp;

//lookup tables for pot readings
const int LUT_L[] = {120,120,120,120,120,120,120,120,120,120,120,120,120,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3976,3976};
const int LUT_D[] = {120,120,120,120,120,120,120,120,120,120,120,120,120,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3976,3976};


//-------------------------------------------------------------------------------------------------------------------

//The PulsePredictor class is responsible for 
// + logging input pulses    + predicting when future pulses will arise
// + knowing whether it is giving good predictions or not
// + relaying pulse events to other bits of code
// + relaying, e.g., cycle times to other bits of code

const int recentPulseTimesArraySize = 10;
const int predictedFuturePulseTimesArraySize = 16;

class PulsePredictor {
  unsigned long int recentPulseTimes[recentPulseTimesArraySize];    //remembers the absolute time of the previous 10 pulses
  unsigned long int predictedFuturePulseTimes[16]; //predicts the absolute time of the next 16 pulses
  signed long int PredictionError[4]; //for the previous N pulses, record the difference between the actual pulse time and what was predicted
  bool TrustworthyPulsePredictions; // records whether the incoming clock is predictable
  bool PulseRecieved; //notes when a pulse has been recieved
  bool TransmitPulse; //notes when a pulse should be transmitted to downstream code segments
  bool PulsesShouldBeTransmitted; //notes whether pulses ought to be transmitted

  public:
  PulsePredictor (); //sets default initialization values  
  void InputPulse (); //engaging this tells the Pulse Predictor that a Pulse has arrived
  unsigned long int TimeOfNthPulse (int n); //returns the estimated time of future pulses
  unsigned long int PulseInterval (int n1, int n2); //returns the expected time between future pulses
  unsigned long int TimeOflastPulsePlusN(int); //returns the time of a pulse in the past. n=0 => last pulse. n=1 is the pulse before that. etc
  bool IsThereAPulse ();
  void RecalculatePredictions ();
  void CheckReliability ();
} InputPulsePredictor;

//sets the default initialization of the PulsePredictor
PulsePredictor::PulsePredictor () {   
  TrustworthyPulsePredictions = false;
  PulseRecieved = false;
  TransmitPulse = false;
  PulsesShouldBeTransmitted = true;
}

void PulsePredictor::InputPulse (){
     //Log the time of the input pulse

     
     //........insert the time in the array of press times, rotating the array to maintain ordering from most to least recent
      for(int i=(recentPulseTimesArraySize-1); i>0; i--){
        recentPulseTimes[i] = recentPulseTimes[i-1];
        }
      recentPulseTimes[0] =  millis();

      //Flag the fact that a pulse has been recieved
      PulseRecieved = true;

      //Flag the the pulse should be transmitted
      if (PulsesShouldBeTransmitted == true){
        TransmitPulse = true;
      }

      //check this time against what the pulse predictor was expecting, and record
      
        for(int i=3; i>0; i--){
         PredictionError[i] = PredictionError[i-1];
        }
      PredictionError[0] = recentPulseTimes[0]-predictedFuturePulseTimes[0];

      CheckReliability (); // check how reliable the last few predictions have been
      RecalculatePredictions (); //recalculate estimates of upcoming pulse times
}


void PulsePredictor::CheckReliability (){
  int sum = 0;
  for (int i=0; i<4; i++){
    sum = sum + PredictionError[i];
  }

  if (sum < 10) { TrustworthyPulsePredictions = true; } else
  { TrustworthyPulsePredictions = false; }
  
}

void PulsePredictor::RecalculatePredictions (){
  //Measure the average of the time between the last two pulses. In future, this can be more sophisticated.
  unsigned long int PulseInterval = (recentPulseTimes[0]-recentPulseTimes[2])/2;

  //Use this to predict the times of future pulses
  for(int i=0; i<predictedFuturePulseTimesArraySize; i++){
    predictedFuturePulseTimes[i] = recentPulseTimes[0]+(i+1)*PulseInterval;
  }

}

bool PulsePredictor::IsThereAPulse() {
  if ( TransmitPulse == true ) {
    TransmitPulse = false; //assume the pulse has now been transmitted - job done!
    return true;
  } else {
    return false;
  }
  
}

unsigned long int PulsePredictor::TimeOfNthPulse (int n){
  if (TrustworthyPulsePredictions){
      return predictedFuturePulseTimes[n-1];
  } else {
    return 0; //this will be the signal that there are no reliable predictions
  }
}


unsigned long int PulsePredictor::TimeOflastPulsePlusN (int n){
  if (TrustworthyPulsePredictions){
      return recentPulseTimes[n];
  } else {
    return 0; //this will be the signal that there are no reliable predictions
  }
}


//----------------------------------------------------------------------------------------------------------------------

// the TrigOutManager is called on to generate output pulses, and handles e.g. giving said pulses a finite length

class TrigOutManager {
  unsigned long TrigLengthMicros, CurrentPulseEndtimeMicros; //Length of trigger pulse in microseconds
  const unsigned long GateModeTimeoutLengthMicros = 20000; //this is the time after initiation that a pulse can be killed by an external function.
  //^ this is neccessary because otherwise, in clock divider mode, through pulses and main pulses which ought to be exactly coincident are actually staggered a little, and if the through pulse comes slightly later - we don't want it to kill the main pulse in that case.
  bool OutputPulseOccuring; //if True, we are in the middle of outputting a pulse
  bool RolloverFlag; //if True, we are in the middle of a pulse which will straddle the point when micros() rolls over

  public:
  TrigOutManager (); //initializes trigger length. Currently this is hardwired into the function.
  void StartPulse();
  void EndPulse();
  bool ShouldWeBeOutputting(bool);
} TrigOutManager_Thru, TrigOutManager_Cycle, TrigOutManager_Main;


//initialize variables
TrigOutManager::TrigOutManager (){
  TrigLengthMicros = 1000;
  //GateModeTimeoutLengthMicros = 20000;
}


void TrigOutManager::StartPulse(){
  OutputPulseOccuring = true;
  CurrentPulseEndtimeMicros = micros() + TrigLengthMicros;
  
  //If the micros() timer is close to rollover, then the value of CurrentPulseEndtimeMicros will have rolled over, as both are unsigned long.
  //Work out if such a rollover has occured:
  if (CurrentPulseEndtimeMicros < TrigLengthMicros){  
    RolloverFlag = true;  } else {  
      RolloverFlag = false; }
}

void TrigOutManager::EndPulse(){
    //We allow a pulse to be cancelled only after a certain amount of time since the pulse started. this is neccessary because otherwise, in clock divider mode, through pulses and main pulses which ought to be exactly coincident are actually staggered a little, and if the through pulse comes slightly later - we don't want it to kill the main pulse in that case.
    if (micros()>(CurrentPulseEndtimeMicros+GateModeTimeoutLengthMicros)){
           OutputPulseOccuring = false;
    }
  //To do: deal with rollover!
}


bool TrigOutManager::ShouldWeBeOutputting(bool GateMode){
  if(OutputPulseOccuring){
  //if gate mode is on, we only stop a pulse when specifically instructed
  //otherwise, we check against the time the current pulse is supposed to end

      if(GateMode==true){
          return true;
        }else{ // check against the time the current pulse is supposed to end
               if(RolloverFlag == false){
                 if (micros()>CurrentPulseEndtimeMicros){
                    OutputPulseOccuring = false;
                   return false;
                  } else {
                    return true;
                 }
               }else{ // RolleverFlag == true
                 if ( (micros()>CurrentPulseEndtimeMicros) && (micros() < 100*TrigLengthMicros) ){
                   OutputPulseOccuring = false;
                   return false;
                 } else {
                   return true;
                 }
              }
        }
  } else { //no output pulse occuring
    return false;
  }
  
}


//------------------------------------------------------------------------------------------------------------
// This will handle clock division/multiplication. Its aim is to spread N output pulses evenly in the space between M 
// input pulses. The end of an input cycle will trigger the end of the output cycle, to ensure sync is maintained.
// To space out pulses correctly, it must recieve information about how long the cycle is expected to last. 

class DividerMultiplier {
  int InputCycleLength,OutputCycleLength,PositionInInputCycle,PositionInOutputCycle,NewPositionTemp, Debug_PositionInOutputCycleOld, intShuffle;
  unsigned long int ExpectedCycleLength, CycleStartTime, ExpectedCycleEndTime, ExpectedIntervalTime, PulseTimes[16], ShuffleTime;
  bool CycleOutPulseStart, MainOutPulseStart, ThruPulseStart, TransmitPulses, TransmitCyclePulses;
  float fractionalShuffle;  
  
  public:
  DividerMultiplier ();
  void CycleReset();
  bool ShouldWeOutputCyclePulse();
  bool ShouldWeOutputMainPulse();
  bool ShouldWeOutputThruPulse();
  void InputPulse();
  void SetInOutCycleLengths(int, int);
  void CalculateOutputTimesAtCycleStart();
  void CalculateOutputTimesMidCycle();
  void UpdateKnobValues(int, int);
  void ShiftPositionInInputCycle(int);
  void UpdateIntShuffleTime(int);
  void PrintPositionInOutputCycle();
  int ReportPositionInCycle();
  void SetPositionInCycle(int);
  
} DividerMultiplierMain;


DividerMultiplier::DividerMultiplier(){   //initalize values
  TransmitPulses = false;  // this is a master switch to turn output on/off
  TransmitCyclePulses = true;
  CycleOutPulseStart = false;   //PulseStart flags are there for the trigger manager to pick up, and signal that an output pulse should be starting
  MainOutPulseStart = false;
  ThruPulseStart = false;
  InputCycleLength = 2;
  OutputCycleLength = 3;
  PositionInInputCycle = 0;  //Counter to keep track of our position in the cycle. Runs from 0 to N-1
  PositionInOutputCycle = 0; 
  CycleStartTime = 0;
  NewPositionTemp = 0;
  fractionalShuffle = 0.0;   //The fraction of an output beat by which the output should be delayed. Expected value between 0 and 1. 
  Debug_PositionInOutputCycleOld = 16;  
  intShuffle = 0;
}

void DividerMultiplier::SetInOutCycleLengths(int in, int out){
  InputCycleLength = in;
  OutputCycleLength = out;
}

void DividerMultiplier::CalculateOutputTimesAtCycleStart() {
 //do not call this until we have enough information to do the calculations!
 ExpectedCycleEndTime = InputPulsePredictor.TimeOfNthPulse(InputCycleLength); 

 if(CycleStartTime !=0 && ExpectedCycleEndTime !=0){

    ExpectedCycleLength = ExpectedCycleEndTime - CycleStartTime;
    ExpectedIntervalTime = ExpectedCycleLength/OutputCycleLength;
  
    //if output cycle length = 0, output nothing 
    if(OutputCycleLength>0){   
        TransmitPulses = true;
    } else {
      TransmitPulses = false;
    }
    
    PulseTimes[0] = CycleStartTime;
    
    //apply shuffle
    PulseTimes[0] = PulseTimes[0] + (fractionalShuffle*ExpectedIntervalTime);
  
    //calculate the remaining output pulse times
      for (int i=1; i < OutputCycleLength; i++){
        PulseTimes[i] = PulseTimes[i-1]+ExpectedIntervalTime;
      }
  }

}

void DividerMultiplier::CalculateOutputTimesMidCycle(){
  //both the input cycle time and output cycle time may have changed, as well as the fractional shuffle

  //first, we need to extrapolate back to when the start of the current input cycle would have been, then calculate the cycle time from that point
  CycleStartTime = InputPulsePredictor.TimeOflastPulsePlusN(PositionInInputCycle);
  ExpectedCycleEndTime = InputPulsePredictor.TimeOfNthPulse(InputCycleLength-PositionInInputCycle);

  if(CycleStartTime !=0 && ExpectedCycleEndTime !=0){
  ExpectedCycleLength = ExpectedCycleEndTime - CycleStartTime;
  ExpectedIntervalTime = ExpectedCycleLength/OutputCycleLength;

  //if output cycle length = 0, output nothing 
  if(OutputCycleLength>0){   
      TransmitPulses = true;
      
      //calculate the output times, adjusting for shuffle
        PulseTimes[0] = CycleStartTime + (fractionalShuffle*ExpectedIntervalTime);  //NB: PulseTimes[0] always falls after the Cycle Start time    
        for (int i=1; i<OutputCycleLength; i++){
          PulseTimes[i] = PulseTimes[i-1] + ExpectedIntervalTime;
        }
    
        //Now work out which pulse is due next
        for (int i=0; i<OutputCycleLength; i++){
          if(PulseTimes[i]>millis()){
            PositionInOutputCycle = i;
            break;
          }
        }
  } else {
    TransmitPulses = false;
  }


  }

}


// registers an input pulse. Advances the input pulse clock.  
//if we reached the end of the cycle, loop back to the start, emit both pulses, and calculate the times for the next set of pulses
void DividerMultiplier::InputPulse() {
  PositionInInputCycle = PositionInInputCycle + 1;
    //If the Main trigger out gate mode is engaged, we need to end any gate-length pulse that might be occuring
   //TrigOutManager_Main.EndPulse();
   ThruPulseStart=true; // pass to thru output

  if (PositionInInputCycle >= InputCycleLength){    
      PositionInInputCycle = 0;
      PositionInOutputCycle = 0;
      CycleOutPulseStart = true;
      if(fractionalShuffle == 0.0){MainOutPulseStart = true;}
      CycleStartTime = millis();
      CalculateOutputTimesAtCycleStart();
  } else {
 //   //If the Main trigger out gate mode is engaged, we need to end any gate-length pulse that might be occuring
 //   TrigOutManager_Main.EndPulse();

  }
      
}

// Accept a "reset" command (i.e. from the "reset" input jack"), which primes the input cycle to reset upon recipt of the next clock pulse

void DividerMultiplier::CycleReset() {
  if(InputCycleLength>1){
      PositionInInputCycle = InputCycleLength - 1;
  }
}


bool DividerMultiplier::ShouldWeOutputCyclePulse(){
  if (TransmitCyclePulses==true){
    if(CycleOutPulseStart){
      CycleOutPulseStart = false; //registers that the instruction has been read
      return true;
      } else {
        return false;
      } 
    } else {
      return false;
    } 
}


bool DividerMultiplier::ShouldWeOutputMainPulse(){
  if (PositionInOutputCycle<OutputCycleLength){ //if this is not true, we already output the last pulse of the cycle and must wait until the recycle is reset
    if (millis() > PulseTimes[PositionInOutputCycle]){ //Check the current time against the time we know the upcoming pulse should start
      PositionInOutputCycle = PositionInOutputCycle + 1;  
      return true;
    } else {  return false; } 
    } else {return false; }
}

  bool DividerMultiplier::ShouldWeOutputThruPulse(){    //Note: pulses from "main" will ALSO be passed to the thru output in divider mode. That's not handled by this function.
    if(ThruPulseStart){
      ThruPulseStart = false; //registers that the instruction has been read
      return true;
      } else {
        return false;
      } 
}

//Adjust cycle paramaters without screwing up our place in the cycle
void DividerMultiplier::UpdateKnobValues(int InCycleLengthKnobPlusCV, int OutCycleLengthKnobPlusCV){
    if (InCycleLengthKnobPlusCV != InputCycleLength){
      InputCycleLength = InCycleLengthKnobPlusCV;
      DividerMultiplier::CalculateOutputTimesMidCycle();
      PositionInInputCycle = PositionInInputCycle % InputCycleLength;
      }
            
    if (OutCycleLengthKnobPlusCV != OutputCycleLength){
      //calculate the new set of times for the output cycle, and figure out where we are in the sequence
      OutputCycleLength = OutCycleLengthKnobPlusCV;
      DividerMultiplier::CalculateOutputTimesMidCycle();
    } 
  }

//change our position in the input cycle
void DividerMultiplier::ShiftPositionInInputCycle(int AmoutToShiftBy){
  if (AmoutToShiftBy != 0){
    NewPositionTemp = PositionInInputCycle + AmoutToShiftBy;

    //code elswhere expect "position in cycle" to be within a range of 0 .... N-1, where N is cycle length.
    //if we've ended up with a position outside this range, find the equivalent value within the range
    
    if (NewPositionTemp >= InputCycleLength){
      NewPositionTemp = NewPositionTemp + 1; //shift to a frame in which we count from 1 ... N, rather than 0 .... N-1, where N is cycle length
      NewPositionTemp = NewPositionTemp % InputCycleLength;
      NewPositionTemp = NewPositionTemp - 1; //shift back
    }
  
    while (NewPositionTemp < 0){
      NewPositionTemp = NewPositionTemp + InputCycleLength;
    }
  
    PositionInInputCycle = NewPositionTemp;
    DividerMultiplier::CalculateOutputTimesMidCycle();  // update output times to reflect where we now are in the input cycle
  }
}

void DividerMultiplier::UpdateIntShuffleTime(int intAmountToChangeBy){
  //intAmountToChangeBy should vary from 0 (no shuffle) to EncoderShuffleNoOfClicks (shuffle of exactly one quantization unit)
  if (intAmountToChangeBy != 0){

    intShuffle = intShuffle + intAmountToChangeBy;
    //fractionalShuffle = fractionalShuffle + AmountToChangeBy;
  
    //force result to a value between 0 and 1;
      while (intShuffle < 0 ){
        intShuffle  = intShuffle + EncoderShuffleNoOfClicks;
      }
    
      while (intShuffle >= EncoderShuffleNoOfClicks){
        intShuffle = intShuffle - EncoderShuffleNoOfClicks;
      }
 
    //Set brightness of the shuffle indicator LED to reflect the amount of shuffle
    analogWrite(LEDPin_Shuffle, EncoderShuffleLedLUT[intShuffle]);

    //convert into fractional shuffle time
    fractionalShuffle = (float)intShuffle/(float)EncoderShuffleNoOfClicks;
    
    //update output times accordingly
    DividerMultiplier::CalculateOutputTimesMidCycle();
  }
}

void DividerMultiplier::PrintPositionInOutputCycle(){
  if(Debug_PositionInOutputCycleOld != PositionInOutputCycle){

      if(PulseTimes[PositionInOutputCycle]>millis()){
        Serial.println("something is wrong!");
      }
  }
  Debug_PositionInOutputCycleOld = PositionInOutputCycle;
}

int DividerMultiplier::ReportPositionInCycle(){
  return PositionInInputCycle;
}

void DividerMultiplier::SetPositionInCycle(int NewPosition){
  PositionInInputCycle = NewPosition;
}


//------------------------------------------------------------------------------------------------------------------------
// EuclieanCalculator will handle euclidean rhythm generation.
//i.e. it will calculate on which beats of the input cycle should an output be triggered
//It will work by spreading m input pulses evenly along a circle, and generating a polygon of k vertices (k = number of hits) inside it. These values will "snap" to the next input pulse.
//"shuffle" will rotate the k-vertex polygon fractionally, such that they eventually snap to different points of the m-vertex polygon
//shift will rotate the k-vertex polygon by one (inter-m-vertex angle)
//to change the zero point of the cycle, we will rely on a (yet to be implemented) cycle reset input


class EuclideanCalculator {
  int InputCycleQuantization, NumberOfHits, mTemp, PositionInInputCycle, NewPositionTemp, InputCycleResetPosition, AmountOfShift, intfractionalShiftOfPolygon;
  bool HitLocationsInCycle [16], MainOutPulseStart, ThruPulseStart, CycleOutPulseStart, TransmitPulses, SnapToClosestPoint;
  float QuantizationPointSpacing, PolygonPointSpacing, QuantizationPointsOnCircle[16], PolygonVertexes[16], fractionalShiftOfPolygon;

  public:
  EuclideanCalculator ();
  void RecalculateRhythm();
  void UpdateKnobValues(int, int, int, float);
  void InputPulse();
  void CycleReset();
  bool ShouldWeOutputMainPulse();
  bool ShouldWeOutputCyclePulse();
  bool ShouldWeOutputThruPulse();
  int ReportPositionInCycle();
  void SetPositionInCycle(int);
  void ShiftPositionInInputCycle(int);
  
} EuclideanCalculatorMain;

EuclideanCalculator::EuclideanCalculator(){   //initalize values. See DividerMultiplier class for description of some variables. 
  InputCycleQuantization = 12;
  NumberOfHits = 5;
  TransmitPulses = true;
  CycleOutPulseStart = false;
  MainOutPulseStart = false;
  ThruPulseStart = false;
  SnapToClosestPoint = false;
  PositionInInputCycle = 0;
  fractionalShiftOfPolygon = 0;
  intfractionalShiftOfPolygon = 0;
  AmountOfShift = 0;
  InputCycleResetPosition = 0; //the position in the input cycle at which we transmit the "cycle" pulse, and which we start at when the sequence restarts. this allows us to manage phase shifts. 
}

int EuclideanCalculator::ReportPositionInCycle(){
  return PositionInInputCycle;
}

void EuclideanCalculator::SetPositionInCycle(int NewPosition){
  PositionInInputCycle = NewPosition;
}

void EuclideanCalculator::UpdateKnobValues(int InCycleQyantizationKnobPlusCV, int NumberOfHitsKnobPlusCV, int ShuffleKnobPlusCV, float ShiftInstruction){

//if any inputs have changed, we need to do something....
  if( (InCycleQyantizationKnobPlusCV != InputCycleQuantization) || (NumberOfHitsKnobPlusCV != NumberOfHits) || (ShuffleKnobPlusCV != 0) || (ShiftInstruction !=0)){

      if(ShuffleKnobPlusCV != 0){
        //we need to make sure the value fits between  0 and EncoderShuffleNoOfClicks, and handle LED output
        //this is duplicated in the DividerMultiplier code - would be tider to rewrite this as one function, at some point
        intfractionalShiftOfPolygon = intfractionalShiftOfPolygon + ShuffleKnobPlusCV;

        while(intfractionalShiftOfPolygon < 0){
          intfractionalShiftOfPolygon = intfractionalShiftOfPolygon + EncoderShuffleNoOfClicks;
        }
        while(intfractionalShiftOfPolygon >= EncoderShuffleNoOfClicks){
           intfractionalShiftOfPolygon = intfractionalShiftOfPolygon - EncoderShuffleNoOfClicks;
        }
        //Set brightness of the shuffle indicator LED to reflect the amount of shuffle
        analogWrite(LEDPin_Shuffle, EncoderShuffleLedLUT[intfractionalShiftOfPolygon]);

        //convert to a value between 0 and 1
        fractionalShiftOfPolygon = (float)intfractionalShiftOfPolygon/(float)EncoderShuffleNoOfClicks;
      }

      if(ShiftInstruction != 0){
        // shfit position in cycle
        AmountOfShift = AmountOfShift + ShiftInstruction;
      }
      
      //adjust shift value to be within the cycle length, just for tidyness, and more logical results when we switch the cycle length
      //while (AmountOfShift >= InputCycleQuantization){
      //  AmountOfShift = AmountOfShift - InputCycleQuantization;
      //}

      //while (AmountOfShift < 0){
      //  AmountOfShift = AmountOfShift + InputCycleQuantization;
      //  Serial.println("Amount of shift still present");
      //}

      // Set length and hits
      InputCycleQuantization = InCycleQyantizationKnobPlusCV;
      NumberOfHits = NumberOfHitsKnobPlusCV;
      EuclideanCalculator::RecalculateRhythm();
      if (InCycleQyantizationKnobPlusCV != InputCycleQuantization){
        PositionInInputCycle = PositionInInputCycle % InputCycleQuantization;  //ensures that we don't screw up position in the input cycle when we change input cycle length
        }
  }

}


void EuclideanCalculator::InputPulse() {
  //registers an input pulse, advances the position in input cycle. If we have reached the end of the cycle, loop back to the start. 
  //if we are at the "InputCycleResetPosition", emit cycle pulse

  PositionInInputCycle = PositionInInputCycle + 1;

  //Pass a thru pulse
  ThruPulseStart=true;

  //If we are in main-out gate mode, end any gate which is occuring
  //TrigOutManager_Main.EndPulse();
  
    if (PositionInInputCycle >= InputCycleQuantization){    
      PositionInInputCycle = 0;
      CycleOutPulseStart = true;
  }

  //now we know where we are in the cycle, figure out if we need to transmit a pulse
  if (HitLocationsInCycle[PositionInInputCycle]==true){
    MainOutPulseStart = true;
    }
  
}



void EuclideanCalculator::CycleReset() {
    if(InputCycleQuantization>0){
        //This will mark the next input pulse as the start of the cycle
        PositionInInputCycle=InputCycleQuantization-1;
    }
}

void EuclideanCalculator::ShiftPositionInInputCycle(int AmountToShiftBy){
  if (AmountToShiftBy != 0){
    NewPositionTemp = PositionInInputCycle + AmountToShiftBy;

    //code elswhere expect "position in cycle" to be within a range of 0 .... N-1, where N is cycle length.
    //if we've ended up with a position outside this range, find the equivalent value within the range

    if (NewPositionTemp >= InputCycleQuantization){
      NewPositionTemp = NewPositionTemp + 1; //shift to a frame in which we count from 1 ... N, rather than 0 .... N-1, where N is cycle length
      NewPositionTemp = NewPositionTemp % InputCycleQuantization;
      NewPositionTemp = NewPositionTemp - 1; //shift back
    }

    while (NewPositionTemp < 0){
      NewPositionTemp = NewPositionTemp + InputCycleQuantization;
    }

    PositionInInputCycle = NewPositionTemp;
    EuclideanCalculator::RecalculateRhythm();
  }

  
}

void EuclideanCalculator::RecalculateRhythm(){

  
  //Spread quantization points along a circle of circumfernece 1; first quantization at 0
  QuantizationPointSpacing = (1.00)/(float)InputCycleQuantization;
  QuantizationPointsOnCircle[0]=0.0;
  for(int i=1; i<InputCycleQuantization; i++){
    QuantizationPointsOnCircle[i] = QuantizationPointsOnCircle[i-1] + QuantizationPointSpacing;
  }
  QuantizationPointsOnCircle[InputCycleQuantization] = 1;
  for(int i = InputCycleQuantization+1; i<16; i++){    
    QuantizationPointsOnCircle[i] = 0;     //set unused values to 0
  }

  if(NumberOfHits == 0){
    //Mark all possible hits as zero. 
    for(int i=0; i<16; i++){
      HitLocationsInCycle[i] = false;
    }
  } else {
    //Draw polygon corresponding to ideal (unquantized) hit locations
      PolygonPointSpacing = (1.00)/(float)NumberOfHits;
  
     //We seed the first vertex of the polygon, accounting for the shuffle and shift amounts
     PolygonVertexes[0] = 0.0 + QuantizationPointSpacing*fractionalShiftOfPolygon;
     //PolygonVertexes[0] = 0.0 + QuantizationPointSpacing*fractionalShiftOfPolygon + QuantizationPointSpacing*AmountOfShift;
     
     //NB: QuantizationPointSpacing*AmountOfShift may have a value of up to one, meaning that when we construct the full polygon, we may have points with values up to 2.0, which we will need to map back on to the circle 0 to 1.0
  
     for(int i=1; i<NumberOfHits; i++){
        PolygonVertexes[i] = PolygonVertexes[i-1] + PolygonPointSpacing;
      }
     for(int i=NumberOfHits; i<16; i++){
        PolygonVertexes[i] = 0;
      }
  
      //ensure all points lie within 0 to 1.0
     for(int i=0; i<NumberOfHits; i++){
      if (PolygonVertexes[i]>=1){
          PolygonVertexes[i] = PolygonVertexes[i] - 1.0;
  
      }
     }
      
    //reset HitLocationsInCycle
    for(int i=0; i<16; i++){
      HitLocationsInCycle[i] = false;
    }
  
    //For each polygon point, find the nearest quantization point clockwise around the circle, and mark as a hit location
    for(int k=0; k<NumberOfHits; k++){
      mTemp =0;
      
      for (mTemp=0; mTemp<=InputCycleQuantization; mTemp++){
        if (QuantizationPointsOnCircle[mTemp] >= PolygonVertexes[k]){break;};
      }
  
      //Deal with the case where we have snapped to the quantization point of the *next* cycle (at 1.0), which is equivalent to the point at 0.0
      if(mTemp == InputCycleQuantization){
        mTemp = 0;
      }
  
        if(SnapToClosestPoint){
            //alternative mode only: for each polygon point, snap to the quantizaiton point *anticlockwise* around the circle, if that is closer than the clockwise one we have identified
            if(mTemp>0){
              if( (QuantizationPointsOnCircle[mTemp]-PolygonVertexes[k]) > (PolygonVertexes[k]-QuantizationPointsOnCircle[(mTemp-1)])){
                mTemp = mTemp-1;
              } 
            }else{
              if( 0.0-PolygonVertexes[k] > ((1+PolygonVertexes[k])-QuantizationPointsOnCircle[InputCycleQuantization-1]) ){
                mTemp = InputCycleQuantization-1;
              }
            }
        }
      HitLocationsInCycle[mTemp] = true;
    } 
  }
}

  bool EuclideanCalculator::ShouldWeOutputMainPulse() {
    if(MainOutPulseStart){
      MainOutPulseStart = false; //registers that the instruction has been read
      return true;
    } else {
      return false;
    }
  }

  bool EuclideanCalculator::ShouldWeOutputCyclePulse(){
    if(CycleOutPulseStart){
      CycleOutPulseStart = false; //registers that the instruction has been read
      return true;
    } else {
      return false;
    }
  }

  bool EuclideanCalculator::ShouldWeOutputThruPulse(){
    if(ThruPulseStart){
      ThruPulseStart = false; //registers that the instruction has been read
      return true;
    } else {
      return false;
    }
  }


//------------------------------------------------------------------------------------------------------------------------
//JitterSmoother is designed to filter out jitter in potentiometer voltages (and CV) which don't correspond to changes in input voltage. 
//This very simple implementation doesn't work especially well, and risks ignoring slow CV changes (eg from a slow LFO). 

class JitterSmoother { 
  int OldValue, NewValue;
  unsigned long int SampleInterval;
  int Threshold;
  unsigned long int TimeOfLastRead;
  
  public:
  JitterSmoother ();
  void SetSampleIntervalandThreshold(unsigned long int,int);
  int SmoothChanges(int);
} JitterSmootherL, JitterSmootherD, JitterSmootherCV, JitterSmootherAttenuverter;


JitterSmoother::JitterSmoother(){   //initalize values
 OldValue = 1;
 NewValue = 1;
 SampleInterval = 60;   //frequency with which we read the knob value
 Threshold = 2;        //if the knob reading (12-bit) changes by more than this amount between reads, we accept the new value 
 TimeOfLastRead = 1;
}

int JitterSmoother::SmoothChanges(int Input){
  if ( (millis() - TimeOfLastRead) > SampleInterval){

    //needed the first time we call the function 
    if (TimeOfLastRead == 1){
      NewValue = Input;
      TimeOfLastRead = millis();
      OldValue = Input;
      return NewValue;  
    }

    //On all the following occasions...
    TimeOfLastRead = millis();  //update for future reference
     
    if ( (Input - OldValue) > Threshold ){  
    NewValue = Input; 
  } else if ( (Input - OldValue) < (-Threshold) ){
    NewValue = Input;
  }  else{
    NewValue = OldValue;
  }

  OldValue = NewValue;
  }
return NewValue;  
}

void JitterSmoother::SetSampleIntervalandThreshold(unsigned long int NewSampleInt, int NewThreshold){
  SampleInterval = NewSampleInt;
  Threshold = NewThreshold;
}

//---------------------------------------------------------------
//ModeController handles switching between different modes of operation

class ModeController {
  bool EuclideanMode, DivMultMode, ThirdMode, MainOutputGateOutMode;
  bool TempModeSwitch1State, TempModeSwitch2State, OldModeSwitch1State, OldModeSwitch2State; // if ModeSwitch1 is high and 2 is low, we are in euclidean mode 
  bool TempOutSwitch1State, TempOutSwitch2State, OldOutSwitch1State, OldOutSwitch2State;
  int ModeSwitchChangeFlag, GateSwitchChangeFlag;
  const int Debouncing_NoOfReads = 6; // Debouncing: when a switch changes state, only accept the new state when it has been constant for the last N reads
  
  public:
  ModeController();
  void ReadModeSwitch();
  void ReadGateSwitch();
  void UpdateMode(bool,bool);
  void UpdateOutputMode(bool,bool);
  bool AreWeInEuclideanMode();
  bool AreWeInDividerMultiplierMode();
  bool AreWeInMainOutputGateMode();
} ModeControllerMaster;

ModeController::ModeController(){ //initialize values
  ModeController::UpdateMode(digitalRead(SwPin_DivEuc),digitalRead(SwPin_DivEuc2));
  ModeSwitchChangeFlag = 0;
  GateSwitchChangeFlag = 0;
  MainOutputGateOutMode = false;
}

void ModeController::ReadModeSwitch(){
  //read position of switch
  TempModeSwitch1State = digitalRead(SwPin_DivEuc);
  TempModeSwitch2State = digitalRead(SwPin_DivEuc2);

  //check if switch position has changed. If yes, then update the mode
  if(TempModeSwitch1State != OldModeSwitch1State || TempModeSwitch2State != OldModeSwitch2State){
    ModeSwitchChangeFlag = 1;
    //the switch position has been changed. If it remains the same next time we measure it, *then* implement the mode change
  } else if (ModeSwitchChangeFlag > 0){
    ModeSwitchChangeFlag = ModeSwitchChangeFlag + 1;
    if(ModeSwitchChangeFlag>Debouncing_NoOfReads){
      ModeController::UpdateMode(TempModeSwitch1State, TempModeSwitch2State);
      ModeSwitchChangeFlag = 0;
    }
  }

  //remember switch position for next time
  OldModeSwitch1State = TempModeSwitch1State;
  OldModeSwitch2State = TempModeSwitch2State;

}


void ModeController::UpdateMode(bool Switch1, bool Switch2){
  if(Switch1 == 0){
    EuclideanMode = false;
    DivMultMode = true;
    ThirdMode = false;
    
    //DividerMultiplierMain.SetPositionInCycle(EuclideanCalculatorMain.ReportPositionInCycle());  
    //DividerMultiplierMain.CalculateOutputTimesMidCycle();
    
  } else if (Switch2 == 0){
    EuclideanMode = true;
    DivMultMode = false;
    ThirdMode = false;
    
    //EuclideanCalculatorMain.SetPositionInCycle(DividerMultiplierMain.ReportPositionInCycle());

  } else if( (Switch1==1) && (Switch2==1) ){
    EuclideanMode = true;
    DivMultMode = true;
    ThirdMode = true;
  }
  
}


void ModeController::ReadGateSwitch(){
  //read position of switch
  TempOutSwitch1State = digitalRead(SwPin_OutModes);
  TempOutSwitch2State = digitalRead(SwPin_OutModes2);

  //check if switch position has changed. If yes, then update the mode
  if(TempOutSwitch1State != OldOutSwitch1State || TempOutSwitch2State != OldOutSwitch2State){
    GateSwitchChangeFlag = 1;
    //the switch position has been changed. If it remains the same next time we measure it, *then* implement the mode change
  } else if (GateSwitchChangeFlag > 0){
    GateSwitchChangeFlag = GateSwitchChangeFlag + 1;
    if(GateSwitchChangeFlag>Debouncing_NoOfReads){
      ModeController::UpdateOutputMode(TempOutSwitch1State, TempOutSwitch2State);
      GateSwitchChangeFlag = 0;
    }
  }

  //remember switch position for next time
  OldOutSwitch1State = TempOutSwitch1State;
  OldOutSwitch2State = TempOutSwitch2State;

}


void ModeController::UpdateOutputMode(bool Switch1, bool Switch2){
  if(Switch1 == 0){
    MainOutputGateOutMode = false;   
  } else if (Switch2 == 0){
    MainOutputGateOutMode = true;
  } else if( (Switch1==1) && (Switch2==1) ){
    MainOutputGateOutMode = false;
  }
}

bool ModeController::AreWeInEuclideanMode(){
  if(EuclideanMode == true){
    return true;
  } else {
    return false;
  }
}

bool ModeController::AreWeInDividerMultiplierMode(){
  if(DivMultMode == true){
    return true;
  } else {
    return false;
  }
}

bool ModeController::AreWeInMainOutputGateMode(){
  if(MainOutputGateOutMode == true){
    return true;
  } else {
    return false;
  }
}

//----------------------------------------------------------------------------------------------------------------------

//the CV assigner will control the routing of CV signals. Currently, everything is controlled by a 3-way switch and this scheme is a bit overkill. but I might want something more sophisticated in future.
class CVassigner {
  bool TempCVbuttonState, OldCVbuttonState, CVdestination [6] {true, false, false, false, false, false}, CVdestinationTemp [6];
//  bool CVcontrolCycleLength, CVcontrolDivisions, CVcontrolShuffle, CVcontrolShift;   <-- I made these to global for now
  float ControlValue_Attenuverter, ControlValue_CVin, ShuffleModifierOld, ShuffleModifierNew, ShuffleModifierChange;
  int intShuffleModifierOld, intShuffleModifierNew, intShuffleModifierChange;
  int CVzeroReading, ShiftModifierOld, ShiftModifierNew, ShiftModifierChange; //the analogRead that results when the control votlage = 0;
  int CyclesSincePreviousButtonPress;
  const int CVscalingFactor = 80; //scales the output of CVassigner::readCV to give a result <2000
  const int ShiftCVScalingFactor = 200; //scales the effect CVassigner::ReturnShiftModifier
  const int ShuffleCVScalingFactor = 80; //scales the effect CVassigner::ReturnShuffleModifier
  const int ButtonRetrigCycles = 10; //for debouncing, only register depression of the switch if it lasts for more than N cycles
  const int CVLedBrightness = 70;


  public:
  CVassigner ();
  void UpdateCVrouting();
  void CheckButton();
  int readCV();
  int ReturnShiftModifier();
  int ReturnIntShuffleModifier(); 
} CVassignerMaster;

CVassigner::CVassigner(){  //default starting state is for CV to control divisions
  CVcontrolCycleLength = false;
  CVcontrolDivisions = true;
  CVcontrolShuffle = false;
  CVcontrolShift = false;
  ControlValue_Attenuverter = 0;
  ControlValue_CVin = 0;
  CVzeroReading = 1710; //this is measured empirically and then hard-coded, for now.
  ShiftModifierOld = 0;
  ShiftModifierNew = 0;
  ShiftModifierChange = 0;
  ShuffleModifierOld = 0.0;
  ShuffleModifierNew = 0.0;
  ShuffleModifierChange = 0.0;
  CyclesSincePreviousButtonPress = 0;
  OldCVbuttonState = 1;
}

void CVassigner::CheckButton(){
    //read button state
    TempCVbuttonState = digitalRead(SwPin_CVassign);   //0 == switch depressed (closed)

    if(TempCVbuttonState == 0){
      if(OldCVbuttonState == 1){  
        //if switch went from open to closed, start counting. only register the press after we've counted a few consecutive cycles of switch depression. This avoids debouncing issues
        CyclesSincePreviousButtonPress = 1;
      } else if (OldCVbuttonState == 0){
        CyclesSincePreviousButtonPress = CyclesSincePreviousButtonPress+1;
        if(CyclesSincePreviousButtonPress==ButtonRetrigCycles){
          CVassigner::UpdateCVrouting();
        }
      }
    }else{
      CyclesSincePreviousButtonPress = 0;
    }

    //remember button state for next time
    OldCVbuttonState = TempCVbuttonState;
}


void CVassigner::UpdateCVrouting(){
//triggered on button press
  
//each element of the CVdestination array correspond to a CV destination, which can be active or inactive
//the first element corresponds to no destination
//on every button press, rotate the array to change the active destination

CVdestinationTemp[0] = CVdestination[5];
for(int i=1; i<6; i++){
  CVdestinationTemp[i] = CVdestination[i-1];
}

for(int i=0; i<6; i++){
  CVdestination[i] = CVdestinationTemp[i];
}



if(CVdestination[1]){
  CVcontrolCycleLength = true;
  analogWrite(LEDPin_CV_ind_Length, CVLedBrightness);
} else {
  CVcontrolCycleLength = false;
  analogWrite(LEDPin_CV_ind_Length, 0);
}


if(CVdestination[2]){
  CVcontrolDivisions = true;
  analogWrite(LEDPin_CV_ind_Divs, CVLedBrightness);
} else {
  CVcontrolDivisions = false;
  analogWrite(LEDPin_CV_ind_Divs, 0);
}

if(CVdestination[3]){
  CVcontrolShuffle = true;
  analogWrite(LEDPin_CV_ind_Shuffle, CVLedBrightness);
} else {
  CVcontrolShuffle = false;
  analogWrite(LEDPin_CV_ind_Shuffle, 0);
}

if(CVdestination[4]){
  CVcontrolShift = true;
  analogWrite(LEDPin_CV_ind_Shift, CVLedBrightness);
} else {
  CVcontrolShift = false;
  analogWrite(LEDPin_CV_ind_Shift, 0);
}



}

//read CV will return an value between +- ~4000, scaled by the attenuverter (CV amt) knob. 
int CVassigner::readCV(){
  ControlValue_Attenuverter = map(analogRead(CtrPin_CVamt),0,4096,+100,-100);
  ControlValue_Attenuverter = map(JitterSmootherAttenuverter.SmoothChanges(analogRead(CtrPin_CVamt)),0,4096,+100,-100);  //read twice to give time for the ADC capacitor to equilibrate, avoiding crosstalk from other analog reads 
  
  
  
  //aside: do we need a voltage smoother on the above?
  ControlValue_CVin = analogRead(InPin_CV);
  ControlValue_CVin = analogRead(InPin_CV);
  ControlValue_CVin = JitterSmootherCV.SmoothChanges(analogRead(InPin_CV))-CVzeroReading; //read twice to give time for the ADC capacitor to equilibrate, avoiding crosstalk from other analog reads 
  
  return (int)(ControlValue_Attenuverter*ControlValue_CVin/CVscalingFactor);

}


int CVassigner::ReturnShiftModifier(){
  //the main fuction controlling shift takes an integer input, which is the amount to shift by: void DividerMultiplier::ShiftPositionInInputCycle(int AmoutToShiftBy)
  //we need to keep track of an overall shift related to CV, and send a signal to that fuction only when control voltage changes cause that shift to change
  
  if ( CVcontrolShift == false ) {
    if (ShiftModifierNew != 0){  //if CV control over shift just got disabled, we want to make sure we reverse any changes which CV control exerted previously
      ShiftModifierOld = ShiftModifierNew;
      ShiftModifierNew = 0;
      return -(ShiftModifierNew-ShiftModifierOld);
    } else {
      return 0; 
    }
  } 

    ShiftModifierOld = ShiftModifierNew; //rememeber shift modifier from last function call
    ShiftModifierNew = (int)(CVassigner::readCV()/ShiftCVScalingFactor);
    ShiftModifierChange = ShiftModifierNew-ShiftModifierOld;
    return -(ShiftModifierChange);

    
}

int CVassigner::ReturnIntShuffleModifier(){
  //Serial.println(intShuffleModifierNew);
  if ( CVcontrolShuffle == false ) {
    if (intShuffleModifierNew != 0){ 
      //if CV control over shuffle just got disabled, we want to make sure we reverse any changes which CV control exerted previously
      Serial.println("trigger");
      intShuffleModifierOld = intShuffleModifierNew;
      intShuffleModifierNew = 0;
      intShuffleModifierChange = intShuffleModifierNew-intShuffleModifierOld;
    } else{
      intShuffleModifierChange = 0; 
    }
  } else { 
    intShuffleModifierOld = intShuffleModifierNew; //rememeber shift modifier from last function call
    intShuffleModifierNew = (CVassigner::readCV()/(float)ShuffleCVScalingFactor); 
    intShuffleModifierChange = intShuffleModifierNew - intShuffleModifierOld;
  }

  return intShuffleModifierChange;
}

//----------------------------------------------------------------------------------------------------------------------
//The knob calibrator is intended to be run one, after assembly of the module, to generate lookup tables which will ensure that knob output matches the ticks on the panel
//Becuase of RAM limitations and small EEPROM, this is going to be a janky process, requiring
// 1) Change "KnobCalibrateMode = 0;" to "CalibrateMode = 1;" (top of Main.ino);
// 2) Load to teensy, and monitor serial output. Follow instructions. 
// 3) Copy and paste output (long string of comma-separated values) from the serial moditor, 1 for each knob
// 4) paste this into some external C code, which must be run to generate the LUTs
// 5) Copy and paste the output of that code into Main.ino 

class KnobCalibrator {
  int CalibrationMeasurements[34],CalibrationMeasurementsAvg[17], CalibrationMeasurementsAvgMidpoints[17], i, j, KnobPin, TempCurrentMap, TempCVbuttonState, OldCVbuttonState, CyclesSincePreviousButtonPress, ButtonRetrigCycles, AvgTemp;
  bool SwitchState, SwitchStateOld, ButtonPressed;
  
  public:
  KnobCalibrator ();
  void SetKnobPin(int);
  void RecordCalibrationValues();
  void TestFunction();
  bool CheckCVButton();
};

KnobCalibrator::KnobCalibrator(){
  OldCVbuttonState = 1;
  ButtonRetrigCycles = 10;
}

void KnobCalibrator::SetKnobPin(int KnobPinTemp){
  KnobPin = KnobPinTemp;
}

bool KnobCalibrator::CheckCVButton(){
    TempCVbuttonState = digitalRead(SwPin_CVassign);   //0 == switch depressed (closed)

    if(TempCVbuttonState == 0){
      if(OldCVbuttonState == 1){  
        //if switch went from open to closed, start counting. only register the press after we've counted a few consecutive cycles of switch depression. This avoids debouncing issues
        CyclesSincePreviousButtonPress = 1;
        OldCVbuttonState = 0;
      } else if (OldCVbuttonState == 0){
        CyclesSincePreviousButtonPress = CyclesSincePreviousButtonPress+1;
        //Serial.println(CyclesSincePreviousButtonPress);
        if(CyclesSincePreviousButtonPress == ButtonRetrigCycles){
          OldCVbuttonState = 0;
          return true;
        }
      }
    }else{
      CyclesSincePreviousButtonPress = 0;
      OldCVbuttonState = 1;
    }

    //remember button state for next time
    OldCVbuttonState = TempCVbuttonState;

    return false;
}

void KnobCalibrator::RecordCalibrationValues(){
  Serial.println("calibration started!");
  Serial.println("Pressing the CV-dest knob will register a knob value");
  Serial.println("For the Length and then Div knob, point the knob it to each tick ( 0 to 16 ) in turn");
  Serial.println("Take two readings (two button presses); one coming from a clockwise turn, the other from counter-clockwise.");
  Serial.println("This helps counter the effects of knob backlash.");

  OldCVbuttonState = 1;

  for(i=0; i<17; i++){
    for(j=0; j<2; j++){
    
       while(KnobCalibrator::CheckCVButton() == false){   
             //wait until CV button is pressed 
             delay(2); //neccessary to avoid bugs
        }

        CalibrationMeasurements[j + 2*i] = analogRead(KnobPin);
        CalibrationMeasurements[j + 2*i] = JitterSmootherL.SmoothChanges(analogRead(KnobPin));
        CalibrationMeasurements[j + 2*i] = JitterSmootherL.SmoothChanges(analogRead(KnobPin));
        CalibrationMeasurements[j + 2*i] = JitterSmootherL.SmoothChanges(analogRead(KnobPin));


      Serial.print(i);
      Serial.print(" ");
      Serial.print(j);
      Serial.print(" ");
      Serial.println(CalibrationMeasurements[j + 2*i]);
    
    }
  }

    //work out the average of each pair of measurements
  for(i=0; i<17; i++){
    CalibrationMeasurementsAvg[i] =  round((int) ((float)CalibrationMeasurements[2*i] + (float)CalibrationMeasurements[(2*i) + 1]) / 2.0 );
  }

  //work out the midpoints between these values
  for(i=0; i<17; i++){
    CalibrationMeasurementsAvgMidpoints[i] =  round((int) ((float)CalibrationMeasurementsAvg[i] + (float)CalibrationMeasurementsAvg[i+1]) / 2.0 );
  }

  Serial.print("{");
  for(i=0; i<15; i++){
    Serial.print(CalibrationMeasurementsAvgMidpoints[i]);
    Serial.print(", ");
  }
  Serial.print(CalibrationMeasurementsAvgMidpoints[15]);
  Serial.println("}");
  
  delay(500);

}
  

//----------------------------------------------------------------------------------------------------------------------

void setup() {
  // put your setup code here, to run once:
  
  //Configure pins
  pinMode(SwPin_DivEuc,INPUT_PULLUP);
  pinMode(SwPin_DivEuc2,INPUT_PULLUP);
  pinMode(SwPin_OutModes,INPUT_PULLUP);
  pinMode(SwPin_OutModes2,INPUT_PULLUP);
  pinMode(SwPin_CVassign,INPUT_PULLUP);
  pinMode(SwPin_Encoder,INPUT);
  pinMode(CtrPin_CVamt,INPUT);
  pinMode(CtrPin_Divisions,INPUT);
  pinMode(CtrPin_Length,INPUT);
  pinMode(OutPin_Cycle,OUTPUT);
  pinMode(OutPin_MainOut,OUTPUT);
  pinMode(OutPin_Thru,OUTPUT);
  pinMode(LEDPin_Shuffle,OUTPUT);
  pinMode(LEDPin_CV_ind_Length,OUTPUT);
  pinMode(LEDPin_CV_ind_Divs,OUTPUT);
  pinMode(LEDPin_CV_ind_Shift,OUTPUT);
  pinMode(LEDPin_CV_ind_Shuffle,OUTPUT);
  pinMode(InPin_Trig,INPUT_PULLUP);
  pinMode(InPin_Reset,INPUT_PULLUP);
  pinMode(InPin_CV,INPUT);
  
  analogReadRes(12);

  Serial.begin(9600);

  EncKnob.write(0);

  JitterSmootherCV.SetSampleIntervalandThreshold(20,25);//tunes the smoothing algorith for the control voltage

}


//----------------------------------------------------------------------------------------------------------------------

void loop() {

  //calibrate mode only
  if(KnobCalibrateMode == 1){
      KnobCalibrator LengthKnobCalibrator, DivsKnobCalibrator;
      LengthKnobCalibrator.SetKnobPin(CtrPin_Length);
      DivsKnobCalibrator.SetKnobPin(CtrPin_Divisions);
      Serial.println("Length knob:");
      LengthKnobCalibrator.RecordCalibrationValues();
      Serial.println("Divs knob:");
      DivsKnobCalibrator.RecordCalibrationValues();
  }

  //Check mode
  ModeControllerMaster.ReadModeSwitch();
  ModeControllerMaster.ReadGateSwitch();
  
  // deal with reset input
  resetInState = digitalRead(InPin_Reset);
  if(resetInState == 0 && resetInPrevState == 1){      //............if the Reset In voltage switches from low to high
    //pass to whatever's controlling the current output mode
      EuclideanCalculatorMain.CycleReset();
      DividerMultiplierMain.CycleReset();
  }
    resetInPrevState = resetInState;    
    
  // deal with clock input
  clockInState = digitalRead(InPin_Trig);
  if(clockInState == 0 && clockInPrevState == 1){      //............if the Trigger In voltage switches from low to high
    //pass to the pulse predictor
    InputPulsePredictor.InputPulse();

    //pass to the output calculators
      EuclideanCalculatorMain.InputPulse();
      DividerMultiplierMain.InputPulse();
  }
    clockInPrevState = clockInState;



  


  //update knob control values
  //we repeat the reading twice, because if we take the first reading, it will still have some residual influence from the previous reading because the capacitor hasn't had time to charge/discharge. 
  ControlValue_Length = analogRead(CtrPin_Length);
  //ControlValue_Length = JitterSmootherL.SmoothChanges(analogRead(CtrPin_Length));
  ControlValue_Length = LUT_L[JitterSmootherL.SmoothChanges(analogRead(CtrPin_Length))];
  ControlValue_Divisions = analogRead(CtrPin_Divisions);
  //ControlValue_Divisions = JitterSmootherD.SmoothChanges(analogRead(CtrPin_Divisions));
  ControlValue_Divisions = LUT_D[JitterSmootherD.SmoothChanges(analogRead(CtrPin_Divisions))];

  //add control voltage to knob value as appriate
  //Prevent the voltage from pushing the control value beyond the normal range of the knob. 
  if (CVcontrolCycleLength == true){
    ControlValue_Length = ControlValue_Length + CVassignerMaster.readCV();
    if(ControlValue_Length < 0){ControlValue_Length = 0;}
    if(ControlValue_Length > 4096){ControlValue_Length = 4096;}
  }
  
  if(CVcontrolDivisions == true){
    ControlValue_Divisions = ControlValue_Divisions + CVassignerMaster.readCV();
    if(ControlValue_Divisions < 0){ControlValue_Divisions = 0;}
    if(ControlValue_Divisions > 4096){ControlValue_Divisions = 4096;}
  }

  //scale control values to be within specified range
  ControlValue_Length_Scaled = map(ControlValue_Length,0,4096,Length_min,Length_max);
  ControlValue_Divisions_Scaled = map(ControlValue_Divisions,0,4096,Divisions_min,Divisions_max);
  
  //For now, don't permit "length" to be 0, as I'm not sure what we would do with that result!
  if(ControlValue_Length_Scaled == 0){
    ControlValue_Length_Scaled = 1;
  }
  
  //check if the encoder has been turned since the last cycle
  EncoderValTemp = -EncKnob.read();

  //If the encoder has been turned, update values accordingly
  if (EncoderValTemp !=  0){
    if((EncoderValTemp % EncoderCountsPerClick) == 0){  //if this is not true, the knob has not reached an indent yet and must be mid-turn - do nothing     
      if(digitalRead(SwPin_Encoder)==0){
         //if the encoder switch was *not* pushed, we update a shift paramater. This will be fed to the Shift function after any control voltage is added
         EncoderShiftInstruction = (int)EncoderValTemp/EncoderCountsPerClick;
      } else if(digitalRead(SwPin_Encoder)==1){
         //if the encoder switch *was* pushed, update a shuffle paramater 
         intEncoderShuffleInstruction = -EncoderValTemp/EncoderCountsPerClick;
      }
      EncKnob.write(0); //Now that we have read the accumulated value from the encoder, reset encoder reading to zero
    }
  }

  //Calculate any CV effects on shift or shuffle
  intShuffleCVInstruction = CVassignerMaster.ReturnIntShuffleModifier();
  ShiftCVInstruction = CVassignerMaster.ReturnShiftModifier();

  //Apply knob+CV changes, including Shift/Shuffle, to output calculations
     EuclideanCalculatorMain.UpdateKnobValues(ControlValue_Length_Scaled, ControlValue_Divisions_Scaled, intEncoderShuffleInstruction + intShuffleCVInstruction, 0);
     EuclideanCalculatorMain.ShiftPositionInInputCycle(EncoderShiftInstruction + ShiftCVInstruction);
     DividerMultiplierMain.UpdateKnobValues(ControlValue_Length_Scaled, ControlValue_Divisions_Scaled);
     DividerMultiplierMain.ShiftPositionInInputCycle(EncoderShiftInstruction + ShiftCVInstruction);
     DividerMultiplierMain.UpdateIntShuffleTime(intEncoderShuffleInstruction + intShuffleCVInstruction);
      

  //reset temporary variables
  EncoderShiftInstruction = 0; 
  intEncoderShuffleInstruction = 0;
  intShuffleCVInstruction = 0;
  ShiftCVInstruction = 0;
  
  //update routing of CV signals
  CVassignerMaster.CheckButton();
  
  // deal with starting output pulses
  //for gate output mode, we need to tell the trigger manager to finish emitting pulse(gate) only if a Thru trigger is signalled without an accompanying main trigger
    // ask euclidean generator whether we should output a pulse
    if(EuclideanCalculatorMain.ShouldWeOutputThruPulse()==true && ModeControllerMaster.AreWeInEuclideanMode()){
        TrigOutManager_Thru.StartPulse();
        TrigOutManager_Main.EndPulse();
      }
    
      if(EuclideanCalculatorMain.ShouldWeOutputCyclePulse()==true && ModeControllerMaster.AreWeInEuclideanMode()){
        TrigOutManager_Cycle.StartPulse();
      }
    
      if(EuclideanCalculatorMain.ShouldWeOutputMainPulse()==true && ModeControllerMaster.AreWeInEuclideanMode()){
        TrigOutManager_Thru.StartPulse();
        TrigOutManager_Main.StartPulse();
      }
  
      if(DividerMultiplierMain.ShouldWeOutputThruPulse()==true && ModeControllerMaster.AreWeInDividerMultiplierMode()){
        TrigOutManager_Thru.StartPulse();
        TrigOutManager_Main.EndPulse();
        TrigOutManager_Main.EndPulse();
      }
    
      if(DividerMultiplierMain.ShouldWeOutputCyclePulse()==true && ModeControllerMaster.AreWeInDividerMultiplierMode()){
        TrigOutManager_Cycle.StartPulse();
      }
    
      if(DividerMultiplierMain.ShouldWeOutputMainPulse()==true && ModeControllerMaster.AreWeInDividerMultiplierMode()){
        TrigOutManager_Thru.StartPulse();
        TrigOutManager_Main.EndPulse();
        TrigOutManager_Main.StartPulse();
      }
    
  //deal with actually setting voltage on the outputs
  if(TrigOutManager_Thru.ShouldWeBeOutputting(false)==true){
    digitalWrite(OutPin_Thru,HIGH);
  } else {
    digitalWrite(OutPin_Thru,LOW);
  }

  if(TrigOutManager_Main.ShouldWeBeOutputting(ModeControllerMaster.AreWeInMainOutputGateMode())){
    digitalWrite(OutPin_MainOut,HIGH);
  } else {
    digitalWrite(OutPin_MainOut,LOW);
  }

  if(TrigOutManager_Cycle.ShouldWeBeOutputting(false)==true){
    digitalWrite(OutPin_Cycle,HIGH);
  } else {
    digitalWrite(OutPin_Cycle,LOW);
  }


}
